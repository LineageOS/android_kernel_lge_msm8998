## drivers/broadcast/oneseg/Kconfig
```kconfig
#
# Broadcast Device Driver Support
#

menu "LGE Japanese Mobile Broadcast(ISDB-T 1seg/ISDB-Tmm 13seg) Device Support"

config LGE_BROADCAST_ISDBT_JAPAN_FC8300
	bool "Japan FULL-SEG broacast tuner chipset FC8300 device driver"
	depends on (LGE_BROADCAST_ISDBT_JAPAN)
	default n
	help
	  Select this if you want to use Japanese FULL-SEG service

endmenu
```
